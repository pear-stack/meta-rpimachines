## conf/layer.conf
```bitbake
# We have a conf and classes directory, add to BBPATH
BBPATH .= ":${LAYERDIR}"

# We have recipes-* directories, add to BBFILES
BBFILES += "${LAYERDIR}/recipes-*/*/*.bb \
            ${LAYERDIR}/recipes-*/*/*.bbappend"

BBFILE_COLLECTIONS += "meta-rpimachine"
BBFILE_PATTERN_meta-rpimachine = "^${LAYERDIR}/"
BBFILE_PRIORITY_meta-rpimachine = "10"

LAYERDEPENDS_meta-rpimachine = "core"
LAYERSERIES_COMPAT_meta-rpimachine = "kirkstone"
```

## conf/machine/include/r02w.inc
```bitbake
MACHINEOVERRIDES =. "r02w:"

include conf/machine/raspberrypi3.conf

MACHINE_EXTRA_RRECOMMENDS += "\
    linux-firmware-rpidistro-bcm43436 \
    linux-firmware-rpidistro-bcm43436s \
    bluez-firmware-rpidistro-bcm43430b0-hcd \
"

RPI_KERNEL_DEVICETREE = " \
    bcm2710-rpi-zero-2.dtb \
    "

VC4DTBO = ""
```

## conf/machine/r02w.conf
```bitbake
require conf/machine/include/r02w.inc

ENABLE_UART = "1"
ENABLE_I2C = "1"

ENABLE_ROTARY_ENCODER = "1"
ENABLE_SYSTEM_LEDS = "1"
ENABLE_SYSTEM_KEYPAD = "1"
ENABLE_SYSTEM_BEEPER = "1"
ENABLE_BME280 = "1"
ENABLE_ADXL345 = "1"

KERNEL_MODULE_AUTOLOAD += "i2c-dev"

RPI_KERNEL_DEVICETREE_OVERLAYS:append = " \
    overlays/system-leds.dtbo \
    overlays/system-keypad.dtbo \
    overlays/rotary-encoder.dtbo \
    overlays/system-beeper.dtbo \
    overlays/i2c-sensor.dtbo \
    overlays/adxl345-i2c.dtbo \
"
```

## conf/machine/r4b.conf
```bitbake
require conf/machine/include/r4b.inc

ENABLE_UART = "1"
ENABLE_I2C = "1"

KERNEL_MODULE_AUTOLOAD += "i2c-dev"
```
