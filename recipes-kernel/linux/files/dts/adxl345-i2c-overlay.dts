/dts-v1/;
/plugin/;

/ {

  compatible = "brcm,bcm2735";

	fragment@0 {
		target = <&i2c1>;
		__overlay__ {
      adxl345@53 {
        compatible = "adi,adxl34x";
        reg = <0x53>;
        interrupt-parent = <&gpio>;
        interrupts = <4 0x8>;
      };
	  };
  };
};
